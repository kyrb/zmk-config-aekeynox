// https://github.com/pierrechevalier83/ferris/

#define SELENIUM_KEYMAP_BINDINGS(LOUT1,  LROW1,  RROW1,  ROUT1, \
                                 LOUT2,  LROW2,  RROW2,  ROUT2, \
                                 LOUT3,  LROW3,  RROW3,  ROUT3, \
                                 LT1, LT2, LT3,  RT3, RT2, RT1) \
    &none &none &none &none &none &none &none &none &none &none &none &none \
    LROW1 &none &none RROW1 \
    LROW2 &none &none RROW2 \
    LROW3 &none &none RROW3 \
    &none &none LT1 LT2 LT3 &none &none RT3 RT2 RT1 &none &none

// This keyboard has limited memory (RAM and Flash).
// Ensure memory-consuming features will be disabled.
#define LOW_MEMORY_DEVICE

#include <aekeynox/selenium.keymap>
